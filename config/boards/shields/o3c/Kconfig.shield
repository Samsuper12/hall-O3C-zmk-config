## config/boards/shields/o3c/Kconfig.shield
```kconfig
# Copyright (c) 2020 The ZMK Contributors
# SPDX-License-Identifier: MIT

config SHIELD_O3C
	def_bool $(shields_list_contains,o3c)
```

## config/west.yml
```yaml
manifest:
  remotes:
    - name: zmkfirmware
      url-base: https://github.com/zmkfirmware
    - name: Samsuper12
      url-base: https://github.com/Samsuper12
  projects:
    - name: zmk
      remote: zmkfirmware
      revision: main
      import: app/west.yml
    - name: hall-sensor-zmk-module
      remote: Samsuper12
      revision: main
    - name: bridge-zmk-module
      remote: Samsuper12
      revision: main
  self:
    path: config
```
